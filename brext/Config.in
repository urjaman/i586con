## brext/Config.in
```kconfig
source "$BR2_EXTERNAL_I586CON_PATH/package/bootbb/Config.in"
source "$BR2_EXTERNAL_I586CON_PATH/package/i586con-savestate/Config.in"
source "$BR2_EXTERNAL_I586CON_PATH/package/fatresize/Config.in"
source "$BR2_EXTERNAL_I586CON_PATH/package/mocp/Config.in"
source "$BR2_EXTERNAL_I586CON_PATH/package/linux-vt-setcolors/Config.in"
source "$BR2_EXTERNAL_I586CON_PATH/package/lcxterm/Config.in"
```

## brext/configs/i586con_defconfig
```kconfig
BR2_JLEVEL=3
BR2_GLOBAL_PATCH_DIR="$(BR2_EXTERNAL_I586CON_PATH)/global-patches"
BR2_TOOLCHAIN_BUILDROOT_MUSL=y
BR2_KERNEL_HEADERS_5_10=y
BR2_TOOLCHAIN_BUILDROOT_CXX=y
BR2_TARGET_GENERIC_HOSTNAME="i586con"
BR2_TARGET_GENERIC_ISSUE="Welcome! (%l)"
BR2_ROOTFS_DEVICE_CREATION_DYNAMIC_EUDEV=y
BR2_ROOTFS_MERGED_USR=y
BR2_TARGET_GENERIC_GETTY_PORT="tty1"
BR2_TARGET_GENERIC_GETTY_TERM="linux"
BR2_TARGET_TZ_INFO=y
BR2_TARGET_LOCALTIME="Europe/Helsinki"
BR2_ROOTFS_USERS_TABLES="$(BR2_EXTERNAL_I586CON_PATH)/board/userlist"
BR2_ROOTFS_OVERLAY="$(BR2_EXTERNAL_I586CON_PATH)/board/rootfs-overlay"
BR2_ROOTFS_POST_BUILD_SCRIPT="$(BR2_EXTERNAL_I586CON_PATH)/board/post_build.sh"
BR2_ROOTFS_POST_FAKEROOT_SCRIPT="$(BR2_EXTERNAL_I586CON_PATH)/board/post_fakeroot.sh"
BR2_ROOTFS_POST_IMAGE_SCRIPT="$(BR2_EXTERNAL_I586CON_PATH)/board/post_image.sh"
BR2_LINUX_KERNEL=y
BR2_LINUX_KERNEL_CUSTOM_VERSION=y
BR2_LINUX_KERNEL_CUSTOM_VERSION_VALUE="5.15.168"
BR2_LINUX_KERNEL_USE_CUSTOM_CONFIG=y
BR2_LINUX_KERNEL_CUSTOM_CONFIG_FILE="$(BR2_EXTERNAL_I586CON_PATH)/board/linux.config"
BR2_LINUX_KERNEL_ZSTD=y
BR2_PACKAGE_BUSYBOX_CONFIG="$(BR2_EXTERNAL_I586CON_PATH)/board/busybox.config"
BR2_PACKAGE_BUSYBOX_SHOW_OTHERS=y
BR2_PACKAGE_ALSA_UTILS=y
BR2_PACKAGE_ALSA_UTILS_APLAY=y
BR2_PACKAGE_XZ=y
BR2_PACKAGE_ZIP=y
BR2_PACKAGE_STRACE=y
BR2_PACKAGE_LIBTOOL=y
BR2_PACKAGE_DOSFSTOOLS=y
BR2_PACKAGE_DOSFSTOOLS_FATLABEL=y
BR2_PACKAGE_DOSFSTOOLS_FSCK_FAT=y
BR2_PACKAGE_DOSFSTOOLS_MKFS_FAT=y
BR2_PACKAGE_E2FSPROGS=y
BR2_PACKAGE_E2FSPROGS_E2IMAGE=y
BR2_PACKAGE_E2FSPROGS_RESIZE2FS=y
BR2_PACKAGE_MTOOLS=y
BR2_PACKAGE_NTFS_3G=y
BR2_PACKAGE_NTFS_3G_NTFSPROGS=y
BR2_PACKAGE_SQUASHFS=y
BR2_PACKAGE_SQUASHFS_ZSTD=y
BR2_PACKAGE_SSHFS=y
BR2_PACKAGE_CDRKIT=y
# BR2_PACKAGE_EUDEV_ENABLE_HWDB is not set
BR2_PACKAGE_FLASHROM=y
BR2_PACKAGE_GPM=y
BR2_PACKAGE_HWDATA=y
BR2_PACKAGE_KBD=y
BR2_PACKAGE_MEMTEST86=y
BR2_PACKAGE_PARTED=y
BR2_PACKAGE_PCIUTILS=y
BR2_PACKAGE_PICOCOM=y
BR2_PACKAGE_SETSERIAL=y
BR2_PACKAGE_SMARTMONTOOLS=y
BR2_PACKAGE_USBUTILS=y
BR2_PACKAGE_PYTHON3=y
BR2_PACKAGE_PYTHON3_READLINE=y
BR2_PACKAGE_PYTHON3_SSL=y
BR2_PACKAGE_PYTHON3_PYEXPAT=y
BR2_PACKAGE_PYTHON3_ZLIB=y
BR2_PACKAGE_PYTHON_SERIAL=y
# BR2_PACKAGE_ALSA_LIB_ALOAD is not set
# BR2_PACKAGE_ALSA_LIB_RAWMIDI is not set
# BR2_PACKAGE_ALSA_LIB_HWDEP is not set
# BR2_PACKAGE_ALSA_LIB_SEQ is not set
# BR2_PACKAGE_ALSA_LIB_UCM is not set
# BR2_PACKAGE_ALSA_LIB_ALISP is not set
# BR2_PACKAGE_ALSA_LIB_OLD_SYMBOLS is not set
BR2_PACKAGE_LIBMAD_OPTIMIZATION_SPEED=y
BR2_PACKAGE_CA_CERTIFICATES=y
BR2_PACKAGE_JPEG=y
BR2_PACKAGE_LIBFTDI=y
BR2_PACKAGE_LIBCURL_CURL=y
# BR2_PACKAGE_LIBCURL_EXTRA_PROTOCOLS_FEATURES is not set
BR2_PACKAGE_LINKS=y
BR2_PACKAGE_LINKS_GRAPHICS=y
BR2_PACKAGE_NTP=y
# BR2_PACKAGE_NTP_NTPD is not set
BR2_PACKAGE_NTP_NTPDATE=y
BR2_PACKAGE_RSYNC=y
BR2_PACKAGE_BASH=y
BR2_PACKAGE_FILE=y
BR2_PACKAGE_GNUPG=y
BR2_PACKAGE_GNUPG_AES=y
BR2_PACKAGE_GNUPG_RSA=y
BR2_PACKAGE_GNUPG_GPGV=y
BR2_PACKAGE_SCREEN=y
BR2_PACKAGE_DDRESCUE=y
BR2_PACKAGE_IOTOP=y
BR2_PACKAGE_KMOD_TOOLS=y
BR2_PACKAGE_TAR=y
BR2_PACKAGE_UTIL_LINUX_BINARIES=y
BR2_PACKAGE_UTIL_LINUX_FDFORMAT=y
BR2_PACKAGE_UTIL_LINUX_PARTX=y
BR2_PACKAGE_MC=y
BR2_PACKAGE_NANO=y
# BR2_PACKAGE_NANO_TINY is not set
BR2_TARGET_ROOTFS_CPIO=y
BR2_TARGET_ROOTFS_CPIO_GZIP=y
BR2_TARGET_ROOTFS_TAR_GZIP=y
BR2_TARGET_GRUB2=y
BR2_TARGET_GRUB2_INSTALL_TOOLS=y
BR2_TARGET_SYSLINUX=y
BR2_PACKAGE_BOOTBB=y
BR2_PACKAGE_BOOTBB_CONFIG="$(BR2_EXTERNAL_I586CON_PATH)/package/bootbb/bootbb.config"
BR2_PACKAGE_I586CON_SAVESTATE=y
BR2_PACKAGE_FATRESIZE=y
BR2_PACKAGE_MOCP=y
BR2_PACKAGE_MOCP_LIBSAMPLERATE=y
BR2_PACKAGE_MOCP_FLAC=y
BR2_PACKAGE_MOCP_CURL=y
BR2_PACKAGE_LINUX_VT_SETCOLORS=y
BR2_PACKAGE_LCXTERM=y
```

## brext/package/bootbb/Config.in
```kconfig
config BR2_PACKAGE_BOOTBB
	bool "Boot BusyBox"
	default n
	help
	  A second copy of busybox to install as /busybox, for special
	  use during the boot process, or as a rescue shell.

	  The Swiss Army Knife of embedded Linux. It slices, it dices,
	  it makes Julian Fries.

	  http://busybox.net/


if BR2_PACKAGE_BOOTBB

config BR2_PACKAGE_BOOTBB_CONFIG
	string "Boot BusyBox configuration file to use?"
	default "package/bootbb/bootbb.config"
	help
	  Path to the configuration file for boot/2nd busybox

endif
```

## brext/package/fatresize/Config.in
```kconfig
config BR2_PACKAGE_FATRESIZE
	bool "fatresize"
	depends on BR2_PACKAGE_PARTED
	default n
	help
	  Resize FAT partitions using libparted

	  https://github.com/ya-mouse/fatresize

comment "fatresize requires parted"
	depends on !BR2_PACKAGE_PARTED
```

## brext/package/i586con-savestate/Config.in
```kconfig
comment "i586con-savestate scripts depend on python3"
	depends on !BR2_PACKAGE_PYTHON3

config BR2_PACKAGE_I586CON_SAVESTATE
	bool "i586con-savestate"
	depends on BR2_PACKAGE_PYTHON3
	help
	  Python scripts used to provide hd_save, cd_save, hdinstall
	  and upgrade_hdi - tools used to save the state of the live system.
```

## brext/package/isohybrid/Config.in
```kconfig
config BR2_PACKAGE_ISOHYBRID
	bool "isohybrid from syslinux"
	depends on BR2_i386 || BR2_x86_64
	help
	  Just the isohybrid tool from syslinux, for the target

	  http://syslinux.org
```

## brext/package/lcxterm/Config.in
```kconfig
comment "lcxterm requires ncurses"
	depends on !BR2_PACKAGE_NCURSES

config BR2_PACKAGE_LCXTERM
	bool "lcxterm"	
	depends on BR2_PACKAGE_NCURSES
	help
	  Linux Console X-like Terminal

	  https://lcxterm.sourceforge.io/
```

## i586con_brext/Config.in
```kconfig
source "$BR2_EXTERNAL_I586CON_PATH/package/bootbb/Config.in"
source "$BR2_EXTERNAL_I586CON_PATH/package/i586con-savestate/Config.in"
source "$BR2_EXTERNAL_I586CON_PATH/package/fatresize/Config.in"
source "$BR2_EXTERNAL_I586CON_PATH/package/mocp/Config.in"
```

## i586con_brext/package/linux-vt-setcolors/Config.in
```kconfig
config BR2_PACKAGE_LINUX_VT_SETCOLORS
	bool "linux-vt-setcolors"
	help
	  Utility tool to set the linux VT default color palette.

	  https://github.com/EvanPurkhiser/linux-vt-setcolors
```

## i586con_brext/package/mocp/Config.in
```kconfig
comment "mocp requires libtool and ncurses"
	depends on !BR2_PACKAGE_LIBTOOL || !BR2_PACKAGE_NCURSES

menuconfig BR2_PACKAGE_MOCP
	bool "mocp"	
	depends on BR2_USE_MMU # fork
	depends on BR2_PACKAGE_LIBTOOL
	depends on BR2_PACKAGE_NCURSES
	help
	  Music On Console Player

	  https://github.com/jonsafari/mocp

if BR2_PACKAGE_MOCP

config BR2_PACKAGE_MOCP_ALSA
	bool "ALSA output"
	default y
        select BR2_PACKAGE_ALSA_LIB
        select BR2_PACKAGE_ALSA_LIB_PCM
        select BR2_PACKAGE_ALSA_LIB_MIXER

config BR2_PACKAGE_MOCP_LIBSAMPLERATE
	bool "libsamplerate"
	select BR2_PACKAGE_LIBSAMPLERATE
	help
	  Enable libsamplerate input support.
	  Select this for software sample rate conversion.
	
config BR2_PACKAGE_MOCP_MAD
	bool "mad"
	default y
	select BR2_PACKAGE_LIBID3TAG
	select BR2_PACKAGE_LIBMAD
	help
	  Enable mad input support.
	  Select this if you want to play back MP3 files.

config BR2_PACKAGE_MOCP_FAAD2
	bool "faad2"
	select BR2_PACKAGE_FAAD2
	help
	  Enable faad2 input support.
	  Select this if you want to play back MP4/AAC files.

config BR2_PACKAGE_MOCP_FLAC
	bool "flac"
	select BR2_PACKAGE_FLAC
	help
	  Enable flac input/streaming support.
	  Select this if you want to play back FLAC files.

config BR2_PACKAGE_MOCP_MODPLUG
	bool "modplug"
	select BR2_PACKAGE_LIBMODPLUG
	help
	  Enable Modplug decoder support.

config BR2_PACKAGE_MOCP_CURL
	bool "curl"
	select BR2_PACKAGE_LIBCURL
	help
	  Enable curl streaming (http) support.

endif
```
